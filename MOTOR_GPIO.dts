/dts-v1/;
/plugin/;

#include <dt-bindings/gpio/gpio.h>
#include <dt-bindings/interrupt-controller/arm-gic.h>
#include <dt-bindings/interrupt-controller/irq.h>
#include <dt-bindings/pinctrl/k3.h>
#include <dt-bindings/board/k3-j721e-bone-pins.h>
#include <dt-bindings/soc/ti,sci_pm_domain.h>
#include <dt-bindings/input/linux-event-codes.h>

&{/chosen} {
	overlays {
		MOTOR_GPIO.kernel = __TIMESTAMP__;
	};
};

&bone_key_P8_26 {
	/* P8_26 - M4.HIGH */
	status = "okay";
    label = "GPIO_OUTPUT_P8_26";
    gpios = <&gpio0 51 GPIO_ACTIVE_HIGH>;
};

&bone_key_P8_14 {
    /* P8_14 - M3.HIGH */
    status = "okay";
    label = "GPIO_OUTPUT_P8_14";
    gpios = <&gpio0 75 GPIO_ACTIVE_HIGH>;
};

/* might not need? */
/cape_header {
    pinctrl-names = "default";
    pinctrl-0 = <
        &P8_26_pruout_pin   /* M4.HIGH */
        &P8_14_pruout_pin   /* M3.HIGH */
};

can also try:

bone_motor_gpio: &main_gpio0 {
    pinctrl-names = "default";
    pinctrl-0 = <
        &P8_26_pruout_pin
        &P8_14_pruout_pin
    >;
    status = "okay";
};

or:

bone_motor_gpio: &ocp {
    pinctrl-names = "default";
    pinctrl-0 = <
        &P8_26_pruout_pin
        &P8_14_pruout_pin
    >;    
}

or:

&ocp {
    P8_26_pinmux { pinctrl-0 = <&P8_26_pruout_pin>; };
    P8_14_pinmux { pinctrl-0 = <&P8_14_pruout_pin>; };
};